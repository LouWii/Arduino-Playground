#include <oled.h>


OLED oled = OLED(2, 3, NO_RESET_PIN, 0x3C, 128, 64, false);

char textDisplayed = 4;
const int displayDelay = 3000;
long lastDisplay = 0;

// 128x64 logo image converted to bytes with http://javl.github.io/image2cpp/
// Background color: black, Code output format Arduino code, single bitmap, Draw mode vertical
// We use PROGMEM to not overload the SRAM (https://www.arduino.cc/reference/en/language/variables/utilities/progmem/)
const uint8_t logoBitmap [] PROGMEM = {
  0x00, 0x00, 0x00, 0x00, 0x00, 0x00, 0x00, 0x00, 0x00, 0x00, 0x00, 0x00, 0x00, 0x00, 0x00, 0x00, 
  0x00, 0x00, 0x00, 0x00, 0x00, 0x00, 0x00, 0x00, 0x00, 0x00, 0x00, 0x00, 0x00, 0x00, 0x00, 0x00, 
  0x00, 0x00, 0x00, 0x00, 0x00, 0x00, 0x00, 0x00, 0x00, 0x00, 0x00, 0x00, 0x00, 0x00, 0x00, 0x00, 
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  0x00, 0x00, 0x00, 0x00, 0x00, 0x00, 0x00, 0x00, 0x00, 0x00, 0x00, 0x00, 0x00, 0x00, 0x00, 0x00
};

void setup() {
  oled.begin();
}

void loop() {
  if (millis() - lastDisplay >= displayDelay || lastDisplay == 0) {

    if (textDisplayed == 4) {
      oled.clear();
      oled.set_contrast(30);
      // Characters available in the library are limited
      oled.println("Hello LouWii!");
      oled.println("It's me, Pro Micro!");
      oled.println("=]");
      oled.display();

      textDisplayed = 1;
      lastDisplay = millis();
    } else if (textDisplayed == 1) {
      oled.clear();
      oled.set_contrast(128);
      oled.println("Scrolling? ");
      oled.display();
      oled.set_scrolling(OLED::HORIZONTAL_LEFT, 0, 0);

      textDisplayed = 2;
      lastDisplay = millis();
    } else if (textDisplayed == 2) {
      // We have to stop the scrolling that way, otherwise it messes up the display
      oled.set_scrolling(OLED::NO_SCROLLING, 0, 0);
      oled.clear();
      // Backslash is "protecting" the next character, we need 2 backslach to display 1
      // The library doesn't display backslashes, displays a white rectangle instead
      oled.println("");
      oled.println("");
      oled.println("   \\\\\\||||||////");
      oled.println("    \\\\  ~ ~  //");
      oled.println("     (  @ @  )");
      oled.println("___oOOo-(_)-oOOo___");
      oled.display();

      textDisplayed = 3;
      lastDisplay = millis();
    }  else if (textDisplayed == 3) {
      oled.clear();
      // draw_bitmap_P loads from program memory, draw_bitmap loads from SRAM
      oled.draw_bitmap_P(0, 0, 128, 64, logoBitmap);
      oled.display();

      textDisplayed = 4;
      lastDisplay = millis();
    }

  }
}
