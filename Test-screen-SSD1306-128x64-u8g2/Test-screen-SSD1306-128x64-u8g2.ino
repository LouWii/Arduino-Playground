#include <U8g2lib.h>

// Rotation, clock pin (SCL/SCK), data pin (SDA)
//U8G2_SSD1306_128X64_NONAME_1_SW_I2C oled(U8G2_R0, 3, 2);
U8G2_SSD1306_128X64_NONAME_1_HW_I2C oled(U8G2_R0);
//U8G2_SSD1306_128X64_NONAME_F_HW_I2C oled(U8G2_R0);

char textDisplayed = 4;
const int displayDelay = 3000;
long lastDisplay = 0;

static const unsigned char logoBitmap [] U8X8_PROGMEM  = {
  0x00, 0x00, 0x00, 0x00, 0x00, 0x00, 0x00, 0x00, 0x00, 0x00, 0x00, 0x00, 0x00, 0x00, 0x00, 0x00, 
  0x00, 0x00, 0x00, 0x00, 0x00, 0x00, 0x00, 0x00, 0x00, 0x00, 0x00, 0x00, 0x00, 0x00, 0x00, 0x00, 
  0x00, 0x00, 0x00, 0x00, 0x00, 0x00, 0x00, 0x00, 0x00, 0x00, 0x00, 0x00, 0x00, 0x00, 0x00, 0x00, 
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  0x00, 0x00, 0x00, 0x00, 0x00, 0x00, 0x00, 0x00, 0x00, 0x00, 0x00, 0x00, 0x00, 0x00, 0x00, 0x00
};

void setup() {
  oled.begin();
  
}

void loop() {
  if (millis() - lastDisplay >= displayDelay || lastDisplay == 0) {

    if (textDisplayed == 4) {
      oled.clear();
      oled.firstPage();
      do {
        oled.setFont(u8g2_font_t0_12_tr);
        oled.setCursor(0, 10);
        oled.print("Hello LouWii!");
        oled.setCursor(0, 20);
        oled.print("It's me, Pro Micro!");
        oled.setCursor(0, 30);
        oled.print("=]");
      } while (oled.nextPage());

      textDisplayed = 1;
      lastDisplay = millis();
    } else if (textDisplayed == 1) {
      // No scrolling animation in this lib
      oled.clear();
      do {
        oled.setFont(u8g2_font_t0_12_tr);
        oled.setCursor(0, 10);
        oled.print("Scrolling ?");
      } while (oled.nextPage());

      textDisplayed = 2;
      lastDisplay = millis();
    } else if (textDisplayed == 2) {
      oled.clear();
      // Backslash is "protecting" the next character, we need 2 backslaches to display 1
      do {
        oled.setFont(u8g2_font_5x7_mf );
        oled.setCursor(0, 9);
        oled.print("");
        oled.setCursor(0, 18);
        oled.print("");
        oled.setCursor(0, 27);
        oled.print("   \\\\\\||||||////");
        oled.setCursor(0, 36);
        oled.print("    \\\\  ~ ~  //");
        oled.setCursor(0, 45);
        oled.print("     (  @ @  )");
        oled.setCursor(0, 54);
        oled.println("___oOOo-(_)-oOOo___");
      } while (oled.nextPage());

      textDisplayed = 3;
      lastDisplay = millis();
    } else if (textDisplayed == 3) {
      oled.clear();
      oled.firstPage();
      do {
        oled.setDrawColor(1);
        oled.setFont(u8g2_font_ncenB14_tr);
        oled.drawXBM(0, 0, 128, 64, logoBitmap);
      } while (oled.nextPage());

      textDisplayed = 4;
      lastDisplay = millis();
    }
  }

}
