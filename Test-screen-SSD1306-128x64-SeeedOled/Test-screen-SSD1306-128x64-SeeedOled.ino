#include <Wire.h>
#include <SeeedOLED.h>

char textDisplayed = 4;
const int displayDelay = 3000;
long lastDisplay = 0;

const uint8_t logoBitmap [] PROGMEM = {
  0x00, 0x00, 0x00, 0x00, 0x00, 0x00, 0x00, 0x00, 0x00, 0x00, 0x00, 0x00, 0x00, 0x00, 0x00, 0x00, 
  0x00, 0x00, 0x00, 0x00, 0x00, 0x00, 0x00, 0x00, 0x00, 0x00, 0x00, 0x00, 0x00, 0x00, 0x00, 0x00, 
  0x00, 0x00, 0x00, 0x00, 0x00, 0x00, 0x00, 0x00, 0x00, 0x00, 0x00, 0x00, 0x00, 0x00, 0x00, 0x00, 
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  0x00, 0x00, 0x00, 0x00, 0x00, 0x00, 0x00, 0x00, 0x00, 0x00, 0x00, 0x00, 0x00, 0x00, 0x00, 0x00
};

void setup() {
  Wire.begin();
  SeeedOled.init();  //initialze SEEED OLED display

  SeeedOled.setBrightness(30);

  SeeedOled.clearDisplay();          //clear the screen and set start position to top left corner
  SeeedOled.setNormalDisplay();      //Set display to normal mode (i.e non-inverse mode)
  SeeedOled.setPageMode();           //Set addressing mode to Page Mode
}

void loop() {
  if (millis() - lastDisplay >= displayDelay || lastDisplay == 0) {

    if (textDisplayed == 4) {
      SeeedOled.clearDisplay();
      //Set the cursor to Xth Page, Yth Column
      SeeedOled.setTextXY(0, 0);
      SeeedOled.putString("Hello LouWii!");
      SeeedOled.setTextXY(1, 0);
      SeeedOled.putString("It's me, Pro Micro!");
      SeeedOled.setTextXY(2, 0);
      SeeedOled.putString("=]");

      textDisplayed = 1;
      lastDisplay = millis();
    } else if (textDisplayed == 1) {
      SeeedOled.clearDisplay();
      // Direction (Scroll_Left, or Scroll_Right), page begin, page end, Speed (Scroll_2Frames, 3, 4, 5, 25, 64, 128, 256)
      SeeedOled.setHorizontalScrollProperties(Scroll_Left, 0, 0, Scroll_2Frames);
      SeeedOled.setTextXY(0, 0);
      SeeedOled.putString("Scrolling? ");
      SeeedOled.activateScroll(); 

      textDisplayed = 2;
      lastDisplay = millis();
    } else if (textDisplayed == 2) {
      // Backslash is "protecting" the next character, we need 2 backslach to display 1
      SeeedOled.deactivateScroll();
      SeeedOled.clearDisplay();
      SeeedOled.setTextXY(0, 0);
      SeeedOled.putString("");
      SeeedOled.setTextXY(1, 0);
      SeeedOled.putString("   \\\\\\||||||////");
      SeeedOled.setTextXY(2, 0);
      SeeedOled.putString("    \\\\  ~ ~  //");
      SeeedOled.setTextXY(3, 0);
      SeeedOled.putString("     (  @ @  )");
      SeeedOled.setTextXY(4, 0);
      SeeedOled.putString("___oOOo-(_)-oOOo___");

      textDisplayed = 3;
      lastDisplay = millis();
    }  else if (textDisplayed == 3) {
      SeeedOled.clearDisplay();
      SeeedOled.drawBitmap((unsigned char*) logoBitmap, 1024);

      textDisplayed = 4;
      lastDisplay = millis();
    }

  }
}
